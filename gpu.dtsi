/*
 * Copyright (c) 2017, The Linux Foundation. All rights reserved.
 *
 * This program is free software; you can redistribute it and/or modify
 * it under the terms of the GNU General Public License version 2 and
 * only version 2 as published by the Free Software Foundation.
 *
 * This program is distributed in the hope that it will be useful,
 * but WITHOUT ANY WARRANTY; without even the implied warranty of
 * MERCHANTABILITY or FITNESS FOR A PARTICULAR PURPOSE.  See the
 * GNU General Public License for more details.
 */

&gpu_bw_tbl {
	compatible = "operating-points-v2";
	opp-0   { opp-hz = /bits/ 64 < 0 >;     }; /* OFF */

	opp-211 { opp-hz = /bits/ 64 < 1611 >;  }; /*  1. 211 MHz */

	opp-278 { opp-hz = /bits/ 64 < 2124 >;  }; /*  2. 278 MHz */

	opp-384 { opp-hz = /bits/ 64 < 2929 >;  }; /*  3. 384 MHz */

	opp-422 { opp-hz = /bits/ 64 < 3222 >;  }; /*  4. 422 MHz */

	opp-556 { opp-hz = /bits/ 64 < 4248 >;  }; /*  5. 556 MHz */

	opp-672 { opp-hz = /bits/ 64 < 5126 >;  }; /*  6. 672 MHz */

	opp-768 { opp-hz = /bits/ 64 < 5859 >;  }; /*  7. 768 MHz */

	opp-806 { opp-hz = /bits/ 64 < 6152 >;  }; /*  8. 806 MHz */

	opp-844 { opp-hz = /bits/ 64 < 6445 >;  }; /*  9. 844 MHz */

	opp-931 { opp-hz = /bits/ 64 < 7104 >;  }; /* 10. 931 MHz */

	opp-1017 { opp-hz = /bits/ 64 < 7759 >;  }; /* 11. 1017 MHz */

	opp-1296 { opp-hz = /bits/ 64 < 9887 >;  }; /* 12. 1296 MHz */

};

&clock_gcc_gfx {
	qcom,gfxfreq-corner =
		 <         0   0 >,
		< 400000000   4 >,  /* SVS Plus  */
		< 510000000   5 >,  /* NOM       */
		< 560000000   6 >,  /* Nom Plus  */
		< 650000000   7 >;  /* Turbo     */
		< 750000000   7 >,  /* Turbo     */
};

&msm_gpu {
	qcom,msm-bus,num-cases = <13>;
	qcom,msm-bus,vectors-KBps =
		<26 512 0 0>,	     /*  off          */
		<26 512 0 1689600>, /* 1. 211.20 MHz */
		<26 512 0 2227200>, /* 2. 278.40 MHz */
		<26 512 0 3072000>, /* 3. 384.00 MHz */
		<26 512 0 3379200>, /* 4.  422.40 MHz */
		<26 512 0 4454400>, /* 5. 556.80 MHz */
		<26 512 0 5376000>, /* 6. 672.00 MHz */
		<26 512 0 6144000>, /* 7. 768.00 MHz */
		<26 512 0 6451200>, /* 8. 806.40 MHz */
		<26 512 0 6758400>, /* 9. 844.80 MHz */
		<26 512 0 7449600>, /*10. 931.20 MHz */
		<26 512 0 8136000>, /*11. 1017.00 MHz */
		<26 512 0 10368000>; /*12. 1296.00 MHz */

	/delete-node/qcom,gpu-pwrlevels;

	qcom,gpu-pwrlevels {
		#address-cells = <1>;
		#size-cells = <0>;

		compatible = "qcom,gpu-pwrlevels";

		/* TURBO LD0 */
		qcom,gpu-pwrlevel@0 {
			reg = <0>;
			qcom,gpu-freq = <750000000>;
			qcom,bus-freq = <12>;
			qcom,bus-min = <12>;
			qcom,bus-max = <12>;
		};

		/* TURBO */
		qcom,gpu-pwrlevel@1 {
			reg = <1>;
			qcom,gpu-freq = <650000000>;
			qcom,bus-freq = <10>;
			qcom,bus-min = <10>;
			qcom,bus-max = <11>;
		};

		/* NOM+ */
		qcom,gpu-pwrlevel@2 {
			reg = <2>;
			qcom,gpu-freq = <560000000>;
			qcom,bus-freq = <10>;
			qcom,bus-min = <8>;
			qcom,bus-max = <10>;
		};

		/* NOM */
		qcom,gpu-pwrlevel@3 {
			reg = <3>;
			qcom,gpu-freq = <510000000>;
			qcom,bus-freq = <9>;
			qcom,bus-min = <6>;
			qcom,bus-max = <10>;
		};

		/* SVS+ */
		qcom,gpu-pwrlevel@4 {
			reg = <4>;
			qcom,gpu-freq = <400000000>;
			qcom,bus-freq = <7>;
			qcom,bus-min = <5>;
			qcom,bus-max = <8>;
		};
	};
};
